
MEMORY
{
  OCRAM (xrw) :   ORIGIN = 0x80000400, LENGTH = 128k - 0x400
  SDRAM (xrw) :   ORIGIN = 0x40000000, LENGTH = 64M
}

REGION_ALIAS("TEXT", OCRAM);
REGION_ALIAS("RAM",  SDRAM);
REGION_ALIAS("ITCRAM", OCRAM);
REGION_ALIAS("DTCRAM", OCRAM);
REGION_ALIAS("RAM2", SDRAM);

INCLUDE rv32i_default_noflash.ld

